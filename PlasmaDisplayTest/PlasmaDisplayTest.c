/*
 * PlasmaDisplayTest.c
 *
 * Created: 15-10-2012 11:27:50
 *  Author: Jelmer Bruijn
 */ 


#include <avr/io.h>
#include <stdlib.h>
#include <avr/pgmspace.h>
#include "PlasmaDisplayTest.h"


const char PROGMEM aperture[] = {
0xFF, 0xFF, 0xFF, 0xFF, 0xFF, 0xFF, 0xFF, 0xFF, 0xFF, 0xFF, 0xFF, 0xFF, 0xFF, 0xFF, 0xFF, 0xFF,
0xFF, 0xFF, 0xFF, 0xFF, 0xFF, 0xFF, 0xFF, 0xFF, 0xFF, 0xFF, 0xFF, 0xFF, 0xFF, 0xFF, 0xFF, 0xFF,
0xFF, 0xFF, 0xFF, 0xFF, 0xFF, 0xFF, 0xFF, 0xFF, 0xFF, 0xFF, 0xFF, 0xFF, 0xFF, 0x7F, 0x7F, 0x7F,
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0xFF, 0xFF, 0xFF, 0xFF, 0xFF, 0xFF, 0xFF, 0xFF, 
};

int main(void){
	DDRD=0xFF;					// this is the databus
	DDRE=0x07;					// control bus: A0 = PE0, _WR = PE2, US = PE1, BUSY = PE3. A0 and US should be low
	PORTE|=(1<<PORTE2);			// set _WR to high
	
	SelectOffscreenPage(0);
	
	SelectDisplayPage(0);
	
	SetCursorMode(1);
	
	FillScreen(aperture);
	
	while(1);
}

void FillScreen(char* PROGMEM image){
	uint8_t row;
	uint16_t column;
	SetCursorPos(1,0);
	for(column=0;column<280;column++){
		SetPixelPos(0,column);
		for(row=0;row<120;row++){
			if(GetBit(image,column,row)){
				WriteData(0x1F);
			} else {
				WriteData(0x1D);
			}
		}
	}
}

void WriteData(uint8_t data){
	while(PINE&(1<<PORTE3));
	PORTD=data;
	PORTE&=~(1<<PORTE2);
	PORTE|=(1<<PORTE2);
}

uint8_t GetBit(char* PROGMEM image,uint16_t column, uint8_t row){
	uint8_t temp = pgm_read_byte(image+(row>>3)*280+column);
	temp&=(1<<(row%8));
	return(temp);
}

void SetCursorMode(uint8_t mode){
	WriteData(0x13+mode);
}

void SelectOffscreenPage(uint8_t page){
	WriteData(0x17);
	WriteData(page);
}

void SelectDisplayPage(uint8_t page){
	WriteData(0x18);
	WriteData(page);
}

void SetPixelPos(uint8_t row, uint16_t column){
	uint8_t colhigh = column/256;
	uint8_t collow = column%256;
	WriteData(0x1A);
	WriteData(row);
	WriteData(colhigh);
	WriteData(collow);
}

void SetCursorPos(uint8_t row, uint8_t col){
	WriteData(0x1C);
	WriteData((row<<4)|col);
}



